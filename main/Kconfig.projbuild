## main/Kconfig.projbuild
```kconfig
menu "HUB75 Hello World"

    choice HUB75_BACKEND
        prompt "Text rendering backend"
        default HUB75_BACKEND_ARDUINO_GFX
        help
            Selects which source file main/CMakeLists.txt compiles.

        config HUB75_BACKEND_NATIVE
            bool "Native ESP-IDF (esphome/esp-hub75 + built-in 5x7 font, no Arduino)"
            help
                Dead end kept for reference: this library initializes but
                produces zero physical output on this board (see RootCause.md).

        config HUB75_BACKEND_ARDUINO_GFX
            bool "Arduino + Adafruit-GFX (ESP32-HUB75-MatrixPanel-DMA)"
            help
                The active, working backend - built with ESP32_HUB75_USE_GFX=n
                so no actual Arduino/Adafruit-GFX dependency is pulled in.
    endchoice

endmenu

menu "HD-WF1 Panel"

    choice PANEL_RESOLUTION
        prompt "Panel resolution"
        default PANEL_RESOLUTION_128X64
        help
            Which physical HUB75E panel is wired to this board. Fixed at
            build time - there is no runtime switch; reflash after changing
            this to drive the other panel.

        config PANEL_RESOLUTION_128X64
            bool "128x64"

        config PANEL_RESOLUTION_64X32
            bool "64x32"
    endchoice

endmenu

menu "HD-WF1 WiFi"

    config WIFI_SSID
        string "WiFi SSID"
        default ""
        help
            SSID of the 2.4 GHz network to connect to. Leave empty to skip
            WiFi entirely. Set via 'idf.py menuconfig' - this is stored only
            in sdkconfig (gitignored), never committed.

    config WIFI_PASSWORD
        string "WiFi password"
        default ""
        help
            Set via 'idf.py menuconfig' - stored only in sdkconfig
            (gitignored), never committed to git.

endmenu

menu "HD-WF1 REST API"

    config HTTP_API_ENABLE
        bool "Enable REST API"
        default y
        help
            HTTP control API, equivalent to the MQTT topics:
            POST /api/command/<name> (body = MQTT payload) and
            GET /api/status. Starts after WiFi connects. Costs a few KB
            of heap (httpd task + sockets) - disable if the lean build
            runs short of memory.

    config HTTP_API_PORT
        int "REST API port"
        default 80
        depends on HTTP_API_ENABLE

    config HTTP_API_TOKEN
        string "REST API bearer token"
        default ""
        depends on HTTP_API_ENABLE
        help
            If non-empty, requests must send "Authorization: Bearer <token>".
            Empty = no authentication (anyone on the LAN can control the
            panel). Set via 'idf.py menuconfig' - stored only in sdkconfig.

    config HTTP_API_MAC_PREFIX
        bool "Prefix REST paths with this device's WiFi MAC"
        default y
        depends on HTTP_API_ENABLE
        help
            When enabled (default), routes become
            POST /api/<mac>/command/<name> and GET /api/<mac>/status, where
            <mac> is this device's WiFi station MAC as 12 lowercase hex
            digits - the same device ID and format used for MQTT topics
            when 'HD-WF1 MQTT' -> 'Prefix hub75/ topics with this device's
            WiFi MAC' is also enabled, so scripts/tooling can derive both
            from one ID. Independent of that MQTT setting - either can be on
            or off regardless of the other. Disable for the legacy flat
            /api/command/<name> and /api/status paths (fine for a single
            board, or when a reverse proxy already routes per device).

endmenu

menu "HD-WF1 MQTT"

    config MQTT_BROKER_URI
        string "MQTT broker URI"
        default ""
        help
            e.g. mqtt://broker.example.com:1883 or mqtts://broker.example.com:8883.
            Leave empty to skip MQTT entirely (also requires WiFi to be
            configured - see 'HD-WF1 WiFi' above). Set via
            'idf.py menuconfig' - stored only in sdkconfig (gitignored),
            never committed to git.

    config MQTT_CLIENT_ID
        string "MQTT client ID"
        default "hd-wf1-hub75"
        help
            This device's WiFi MAC (12 lowercase hex digits) is always
            appended as "-<mac>" at runtime, so the same build can be
            flashed onto multiple boards sharing one broker without their
            client IDs colliding (MQTT requires unique client IDs per
            broker - a collision makes the second board's connect silently
            disconnect the first, rather than erroring loudly). Leave this
            as a short, human-readable prefix; don't add your own unique
            suffix here.

    config MQTT_USERNAME
        string "MQTT username"
        default ""
        help
            Leave empty if the broker doesn't require authentication.

    config MQTT_PASSWORD
        string "MQTT password"
        default ""
        help
            Set via 'idf.py menuconfig' - stored only in sdkconfig
            (gitignored), never committed to git.

    config MQTT_STATUS_TOPIC
        string "MQTT status topic"
        default "hub75/status"
        help
            Retained "online"/"offline" (LWT) messages are published here.

    config MQTT_MESSAGE_TOPIC
        string "MQTT message topic"
        default "hub75/message"
        help
            Subscribed on connect. Payload is JSON:
            {"text": "Hello!", "color": "#RRGGBB"} - "color" is optional
            and defaults to green if omitted.

    config MQTT_TOPIC_MAC_PREFIX
        bool "Prefix hub75/ topics with this device's WiFi MAC"
        default y
        help
            When enabled (default), every hub75/<topic> command is
            subscribed/matched as hub75/<mac>/<topic> instead - where <mac>
            is this device's WiFi station MAC as 12 lowercase hex digits,
            e.g. hub75/a1b2c3d4e5f6/red - so multiple boards can share one
            broker without colliding on the same topic names. The status
            topic above and a message topic left at its "hub75/..." default
            are namespaced the same way; a message topic customized to a
            fully different (non-"hub75/"-prefixed) topic is never touched.
            The REST API's own MAC prefix ('HD-WF1 REST API' ->
            'Prefix REST paths with this device's WiFi MAC') is independent
            of this setting. Disable for the legacy flat hub75/<topic>
            scheme (fine for a single board on a broker).

endmenu

menu "HD-WF1 Default Text"

    config DEFAULT_TEXT
        string "Default text to display"
        default ""
        help
            Shown on the panel (DisplayMode::kMessage) before any
            hub75/message MQTT/REST command has ever been received - see
            display_text in main.cpp. Leave empty to show a blank
            screen/scroll until a real message arrives. A later
            hub75/message command overwrites this text (and its color)
            for the rest of that boot; there's no way back to this default
            without a reboot.

    choice DEFAULT_TEXT_FONT
        prompt "Default text font"
        default DEFAULT_TEXT_FONT_8X8
        help
            Font used to render DisplayMode::kMessage - both this default
            text and any text later sent via hub75/message share the same
            renderer, so this choice affects both, not just the boot
            default.

        config DEFAULT_TEXT_FONT_8X8
            bool "8x8 (full ASCII, scrolls)"
            help
                font8x8_basic.h - covers the full printable ASCII range.
                Scrolls right-to-left when wider than the panel, same as
                every hub75/message today.

        config DEFAULT_TEXT_FONT_SMALL
            bool "Compact 3x5 (fits without scrolling)"
            help
                The same narrow font used for the WiFi status screen (see
                small_font_glyph() in main.cpp) - deliberately covers only
                digits, space, '.', '=', and the specific letters those
                fixed status messages use. Any other character (most
                consonants and all uppercase letters) renders as blank
                space, so this is only safe for short text you've checked
                against small_font_glyph()'s switch statement - risky for
                arbitrary sentences. Centered, does not scroll; text wider
                than the panel is simply clipped.
    endchoice

    config DEFAULT_TEXT_FG
        string "Default text foreground color (#RRGGBB)"
        default "#00FF00"
        help
            Hex color, same "#RRGGBB" format as other hub75/* JSON color
            fields. Invalid or empty falls back to green (#00FF00) at boot.

    config DEFAULT_TEXT_BG
        string "Default text background color (#RRGGBB)"
        default "#000000"
        help
            Hex color for the panel background behind DisplayMode::kMessage
            text (both this default and any later hub75/message, per
            'Default text font' above - there's no separate per-message bg
            field today). Invalid or empty falls back to black (#000000).

endmenu

menu "HD-WF1 Ping"

    config PING_TARGETS
        string "Ping targets"
        default "192.168.92.1"
        help
            Comma-separated list of up to 8 targets pinged by hub75/ping1
            and hub75/ping2. Each entry is HOST or HOST:PORT - HOST is a
            literal IPv4 address or a hostname (resolved via DNS at ping
            time), PORT is optional and only used when 'Ping method' below
            is TCP connect (falls back to 'Default TCP ping port' if
            omitted). Example: "192.168.92.1,example.com:8080,10.0.0.5:22".
            Every ping (each hub75/ping1/ping2 sample) picks one target at
            random from this list - a random round-robin across all of
            them, not a fixed sequence. Set via 'idf.py menuconfig'.

    choice PING_METHOD
        prompt "Ping method"
        default PING_METHOD_ICMP
        help
            How hub75/ping1 and hub75/ping2 measure latency to whichever
            target above was picked for that sample.

        config PING_METHOD_ICMP
            bool "ICMP echo (standard ping)"
            help
                A normal ICMP echo request/reply, timed round-trip. Many
                hosts and firewalls silently drop these, which reads as a
                permanent timeout.

        config PING_METHOD_TCP
            bool "TCP connect (tcpping)"
            help
                Times a TCP three-way handshake to the port below instead of
                an ICMP echo - works through firewalls that block ICMP but
                allow a specific TCP port. A closed port (connection refused)
                counts the same as a timeout, so pick a port that's actually
                open on the target.
    endchoice

    config PING_TARGET_TCP_PORT
        int "Default TCP ping port"
        default 80
        range 1 65535
        depends on PING_METHOD_TCP
        help
            Port used for any entry in 'Ping targets' above that doesn't
            specify its own PORT. Only relevant when 'Ping method' is TCP
            connect.

endmenu

menu "HD-WF1 Power"

    config MAX_BRIGHTNESS
        int "Maximum panel brightness (1-255) used by hub75/bright"
        range 1 255
        default 128
        help
            hub75/bright sets the panel to this brightness (hub75/dim stays at 32).
            A full-panel solid color at 255 draws the most current a 128x64
            panel can, and on an undersized 5V supply that browns out the
            ESP32 (boot banner "RR=9", ESP_RST_BROWNOUT). Lower this until
            the supply holds; raise it once the panel has a proper 5V feed.
            Brightness changes are also ramped up gradually rather than
            stepped, to avoid an inrush spike.

endmenu

menu "HD-WF1 NTP"

    config NTP_SERVER1
        string "Primary NTP server"
        default "pool.ntp.org"
        help
            Used for hub75/ntpset and the initial time sync (requires WiFi -
            see 'HD-WF1 WiFi' above).

    config NTP_SERVER2
        string "Secondary NTP server (optional)"
        default ""
        help
            Leave empty to use only the primary server.

endmenu

menu "HD-WF1 Boot Splash"

    comment "Up to 4 lines of text (e.g. owner contact info) shown yellow-on-black for 10s at boot."
    comment "Keep the real values in sdkconfig (gitignored), not sdkconfig.defaults. All empty = no splash."

    config SPLASH_LINE1
        string "Splash line 1"
        default ""

    config SPLASH_LINE2
        string "Splash line 2"
        default ""

    config SPLASH_LINE3
        string "Splash line 3"
        default ""

    config SPLASH_LINE4
        string "Splash line 4"
        default ""

endmenu
```
